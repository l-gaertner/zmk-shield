## boards/shields/ludini/Kconfig.defconfig
```kconfig
# Copyright (c) 2022 The ZMK Contributors
# SPDX-License-Identifier: MIT

if SHIELD_SPLITKB_AURORA_SWEEP_LEFT
config ZMK_SPLIT
    default y

config ZMK_KEYBOARD_NAME
    default "Ludini"

config ZMK_SPLIT_ROLE_CENTRAL
    default y

endif # SHIELD_SPLITKB_AURORA_SWEEP_LEFT

if SHIELD_SPLITKB_AURORA_SWEEP_RIGHT || SHIELD_SPLITKB_AURORA_SWEEP_LEFT

config ZMK_SPLIT_ROLE_CENTRAL
    default n

config CONFIG_BT
    default y

config CONFIG_ZMK_BLE
    default y

endif # SHIELD_SPLITKB_AURORA_SWEEP_RIGHT
```

## config/boards/shields/dwarf/Kconfig.defconfig
```kconfig
# Copyright (c) 2022 The ZMK Contributors
# SPDX-License-Identifier: MIT

if SHIELD_MY_KEYBOARD

config ZMK_KEYBOARD_NAME
    default "dwarf"

endif
```

## config/boards/shields/dwarf/Kconfig.shield
```kconfig
# Copyright (c) 2022 The ZMK Contributors
# SPDX-License-Identifier: MIT

config SHIELD_MY_KEYBOARD
    def_bool $(shields_list_contains,dwarf)
```

## config/boards/shields/ludini/Kconfig.shield
```kconfig
# Copyright (c) 2022 The ZMK Contributors
# SPDX-License-Identifier: MIT

config SHIELD_LUDINI_SWEEP_LEFT
    def_bool $(shields_list_contains,splitkb_ludini_sweep_left)

config SHIELD_LUDINI_SWEEP_RIGHT
    def_bool $(shields_list_contains,splitkb_ludini_sweep_right)
```
